/*
 * Device Tree Source for IGEP COM MODULE Rev. G (TI OMAP AM/DM37x)
 *
 * Copyright (C) 2014 Javier Martinez Canillas <javier@osg.samsung.com>
 * Copyright (C) 2014 Enric Balletbo i Serra <eballetbo@gmail.com>
 *
 * This program is free software; you can redistribute it and/or modify
 * it under the terms of the GNU General Public License version 2 as
 * published by the Free Software Foundation.
 */

#include "omap3-igep0030-common.dtsi"

/ {
	model = "IGEP COM MODULE Rev. G (TI OMAP AM/DM37x)";
	compatible = "isee,omap3-igep0030-rev-g", "ti,omap36xx", "ti,omap3";
};

